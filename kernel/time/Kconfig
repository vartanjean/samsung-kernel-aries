## kernel/time/Kconfig
```kconfig
#
# Timer subsystem related configuration options
#
config TICK_ONESHOT
	bool

config NO_HZ
	bool "Tickless idle system (Dynamic idle Ticks)"
	depends on !ARCH_USES_GETTIMEOFFSET && GENERIC_CLOCKEVENTS
	select TICK_ONESHOT
	help
	  This option enables a tickless idle system: timer interrupts will
	  only trigger on an as-needed basis when the system is idle.

config NO_HZ_FULL
        bool "Full tickless system (Dynamic Ticks)"
	depends on NO_HZ && HAVE_NO_HZ_FULL
	help
	  This option enables a full adaptive tickless system: timer
	  interrupts will globally only trigger on an as-needed basis.

config HIGH_RES_TIMERS
	bool "High Resolution Timer Support"
	depends on !ARCH_USES_GETTIMEOFFSET && GENERIC_CLOCKEVENTS
	select TICK_ONESHOT
	help
	  This option enables high resolution timer support. If your
	  hardware is not capable then this option only increases
	  the size of the kernel image.

config GENERIC_CLOCKEVENTS_BUILD
	bool
	default y
	depends on GENERIC_CLOCKEVENTS || GENERIC_CLOCKEVENTS_MIGR
```
